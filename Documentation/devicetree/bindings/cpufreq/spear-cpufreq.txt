## drivers/char/c3/Kconfig
```kconfig
#
# C3 driver configuration
#

menu "C3 support"

config C3_DRIVER
	tristate "C3 driver"
	depends on ARCH_SPEAR3XX || ARCH_SPEAR13XX
	help
	  	C3 is a crypto accelerator.

choice
	depends on C3_DRIVER
	prompt "C3 device type"
	help
        C3 platform setting.

config C3_DRIVER_SPEARBASIC_REVA
    bool "C3 on Spearbasic rev-A" if ARCH_SPEAR300 || ARCH_SPEAR3XX
    help
    	C3 on Spearbasic rev-A.

config C3_DRIVER_SPEARBASIC_REVBA
    bool "C3 on Spearbasic rev-BA" if ARCH_SPEAR300 || ARCH_SPEAR3XX
 	help
    	C3 on Spearbasic rev-BA.

config C3_DRIVER_SPEAR13xx
    bool "C3 on Spear13xx" if ARCH_SPEAR13XX
    help
    	C3 on Spear13XX.

endchoice

config C3_DRIVER_DEBUG
	bool "Enable debug"
	depends on C3_DRIVER
	help
	  This setting enables debug.

config AUTO_TEST
	bool "C3 autotest on boot"
	help
	  This setting enables default kernel level testing for different
	  crypto algo. Say Y to enable it during kernel booting.

config C3_CRYPTOAPI_INTEGRATION
	tristate "C3 Linux-CryptoAPI Integration"
	depends on C3_DRIVER
		select CRYPTO_AES
        	select CRYPTO_ALGAPI
	        select CRYPTO_AUTHENC
        	select CRYPTO_BLKCIPHER
		select CRYPTO_AEAD
		select CRYPTO_HASH
		select CRYPTO_CBC
		select CRYPTO_CTR
		select CRYPTO_HMAC
	help
	  	Module for integration with Linux CryptoAPI (Kernel version 2.6.37).
	  	Support for offloading asynchronous AES(CTR,CBC), SHA-1,HMAC(SHA-1) operations to the C3 Hardware.

endmenu
```

## drivers/gpu/mali/Kconfig
```kconfig
menuconfig GPU_MALI
	tristate "ARM Mali 200/300/400 support"
	depends on ARM
	---help---
	This enables support for the ARM Mali 200/300/400 family of GPUs.
	Platform specific configuration is made in configuration files in the
	drivers/gpu/mali/ folder

config GPU_MALI_DEBUG
	boolean "Debug mode (required for instrumentation)"
	default y
	depends on GPU_MALI
	---help---
	This enables debug prints in the mali device driver. Debug mode must be
	enabled in order to use the intrumentation feature of the mali libraries.

config GPU_MALI_UMP
	tristate "ARM Mali 200/300/400 UMP support"
	default y
	depends on GPU_MALI
	---help---
	This enables support to UMP (Unified Memory Provider) in the mali device
	driver, needed to enable kernel-level support for DRI in XFree86 4.0.
```

## drivers/media/video/spear/Kconfig
```kconfig
menuconfig VIDEO_SPEAR_HWVIDEO
	tristate "SPEAr video HW drivers"
	depends on ARCH_SPEAR13XX
	---help---
	  Support for SPEAr1340 video HW drivers.

config VIDEO_SPEAR_VIDEODEC
	tristate "SPEAr video decoder"
	depends on VIDEO_SPEAR_HWVIDEO
	select VIDEO_SPEAR_HWVIDEO_MEMALLOC
	---help---
	  Support for SPEAr1340 video decoders driver.

config VIDEO_SPEAR_VIDEODEC_DEBUG
	bool "SPEAr video decoder debug"
	depends on VIDEO_SPEAR_VIDEODEC
	default no
	---help---
	  Enable debug messages for SPEAr video decoder driver.

config VIDEO_SPEAR_VIDEOENC
	tristate "SPEAr video encoder"
	depends on VIDEO_SPEAR_HWVIDEO
	select VIDEO_SPEAR_HWVIDEO_MEMALLOC
	---help---
	  Support for SPEAr1340 video encoder driver.

config VIDEO_SPEAR_VIDEOENC_DEBUG
	bool "SPEAr video encoder debug"
	depends on VIDEO_SPEAR_VIDEOENC
	default no
	---help---
	  Enable debug messages for SPEAr video encoder driver.

config VIDEO_SPEAR_HWVIDEO_MEMALLOC
	tristate "SPEAr video decoder memory allocator"
	depends on VIDEO_SPEAR_HWVIDEO
	---help---
	  Support linear physical memory allocator for
	  SPEAr video decoder driver.

config VIDEO_SPEAR_HWVIDEO_MEMALLOC_DEBUG
	bool "SPEAr video decoder memory allocator debug"
	depends on VIDEO_SPEAR_HWVIDEO_MEMALLOC
	default no
	---help---
	  Enable debug messages for SPEAr video decoder physical memory
	  allocator.
```

## drivers/mmc/core/Kconfig
```kconfig
#
# MMC core configuration
#

config MMC_UNSAFE_RESUME
	bool "Assume MMC/SD cards are non-removable (DANGEROUS)"
	help
	  If you say Y here, the MMC layer will assume that all cards
	  stayed in their respective slots during the suspend. The
	  normal behaviour is to remove them at suspend and
	  redetecting them at resume. Breaking this assumption will
	  in most cases result in data corruption.

	  This option is usually just for embedded systems which use
	  a MMC/SD card for rootfs. Most people should say N here.

	  This option sets a default which can be overridden by the
	  module parameter "removable=0" or "removable=1".

config DISABLE_HS_SWITCH
	bool "Prevent switching MMC/SD to high speed operations"
	help
	  If you say Y here, the MMC core would not switch to high speed
	  for cards that support these operations.

	  This option is just for situation where high speed timings are
	  not met and users would want to continue with normal functionality.
```
