## Documentation/devicetree/bindings/cpufreq/spear-cpufreq.txt
```
SPEAr cpufreq driver

It is a SPEAr SOC cpufreq driver for CPU0 frequency management.  It
supports both uniprocessor (UP) and symmetric multiprocessor (SMP)
systems which share clock across all CPUs.

Both required and optional properties listed below must be defined
under node /cpus/cpu@0.

Required properties:
- operating-freqs: Range of frequencies CPU could be transitioned into
, in the increasing order. 

Optional properties:
- clock-latency: Specify the possible maximum transition latency for clock,
  in unit of nanoseconds.

Examples:

cpus {
	#address-cells = <1>;
	#size-cells = <0>;

	cpu@0 {
		compatible = "arm,cortex-a9";
		reg = <0>;
		next-level-cache = <&L2>;
		operating-freqs = <
			/* kHz */
			333000
			500000
			600000
		>;
		clock-latency = <61036>; /* two CLK32 periods */
	};

	cpu@1 {
		compatible = "arm,cortex-a9";
		reg = <1>;
		next-level-cache = <&L2>;
	};

	cpu@2 {
		compatible = "arm,cortex-a9";
		reg = <2>;
		next-level-cache = <&L2>;
	};

	cpu@3 {
		compatible = "arm,cortex-a9";
		reg = <3>;
		next-level-cache = <&L2>;
	};
};
```

## Documentation/devicetree/bindings/fb/db9000fb.txt
```
* Digital Blocks clcd controller

Required properties:
- compatible : should be "st,db9000-clcd".
- reg : Address range of the db9000-clcd registers:
- interrupt-parent : the phandle for the interrupt controller that
  services interrupts for this device.
- interrupt: Should contain the sdhci interrupt number

Optional properties:
- mode : select a video mode:
    <xres>x<yres>[-<bpp>][@<refresh>]
-ignore_cpufreq_notification: if cpu and db9000fb share the same pll
then mark it 0 other wise mark it 1.

Example for digital blocks (db9000fb):
	clcd@e1000000 {
		compatible = "st,db9000-clcd";
		reg = <0xe1000000  0x1000>;
        interrupts = <0 13 0x4>;
		mode = "1024x768-32@60";
	};
```

## Documentation/devicetree/bindings/gpio/gpio-spics.txt
```
=== SPI CS Driver ===

SPEAr platform provides a provision to control chipselects of ARM PL022
Prime Cell spi controller through its system registers, which otherwise
remains under PL022 control. If chipselect remain under PL022 control
then they would be released as soon as transfer is over and TxFIFO
becomes empty. This is not desired by some of the device protocols above
spi which expect (multiple) transfers without releasing their chipselects.

Chipselects can be controlled by software by turning them as GPIOs.
SPEAr provides another interface through system registers through which
software can directly control each PL022 chipselect. Hence, it is
natural for SPEAr to export the control of this interface as gpio. 


Required properties:

  * compatible: should be defined as "st,spear-spics-gpio"
  * st-spics,peripcfg-reg: peripheral configuration register offset
  * st-spics,sw-enable-bit: bit offset to enable sw control
  * st-spics,cs-value-bit: bit offset to drive chipselect low or high
  * st-spics,cs-enable-mask: chip select number bit mask
  * st-spics,cs-enable-shift: chip select number program offset
  * gpio-controller: Marks the device node as gpio controller
  * #gpio-cells: should be 2

All the above bit offsets are within peripcfg register.
```

## Documentation/devicetree/bindings/i2c/i2c-designware.txt
```
* Synopsys DesignWare I2C

Required properties :

 - compatible : should be "snps,designware-i2c"
 - reg : Offset and length of the register set for the device
 - interrupts : <IRQ> where IRQ is the interrupt number.

Recommended properties :

 - clock-frequency : desired I2C bus clock frequency in Hz.

Optional properties :
 - stop-control : boolean value which suggests that the controller has
 been configured with 'IC_EMPTYFIFO_HOLD_MASTER_EN' option, meaning that
 s/w needs to write command to generate stop with the last byte of
 transfer.

Example :

	i2c@f0000 {
		#address-cells = <1>;
		#size-cells = <0>;
		compatible = "snps,designware-i2c";
		reg = <0xf0000 0x1000>;
		interrupts = <11>;
		stop-control;
		clock-frequency = <400000>;
	};
```

## Documentation/devicetree/bindings/input/lsm303dlh_a.txt
```
* ST LSM303DLH 3-Axis Accelerometer

Required properties:
- compatible : "st,lsm303dlh_a".
- reg: the I2C address of LSM303DLH Accelerometer.
- name_a : Acelerometer name (name of device for regulator).
- axis_map_x, _y,_z : Orientation of Acceleremeter about reference x, y, z
  axis. The value should be betwwen 0 to 2.
- input_poll_dev : Input device for polling.
- irq_a1, _a2 : Interrupt line 1 and 2 of LSM303DLH Accelerometer.

Optional properties:
- negative_x, _y, _z : Orientation of Acceleremeter about negative reference x,
  y, z axis. The value should be between 0 and 1.

Example:

accelerometer: lsm303dlh_a@0x19 {
	compatible = "st,lsm303dlh_a";
	reg = <0x19>;
	name_a = "lsm303dlh_a";
	axis_map_x = <0>;
	axis_map_y = <1>;
	axis_map_z = <2>;
	input_poll_dev = <1>;
	irq_a1 = <&gpiocontrol 71 0>;
	irq_a2 = <&gpiocontrol 75 0>;;
};
```

## Documentation/devicetree/bindings/input/lsm303dlh_m.txt
```
* ST LSM303DLH Magnetometer

Required properties:
- compatible : "st,lsm303dlh_m".
- reg: the I2C address of LSM303DLH Magnetometer.
- name_m : Magnetometer name (name of device for regulator).
- axis_map_x, _y,_z : Orientation of Magnetometer about reference x, y, z.
  axis. The value should be betwwen 0 to 2.
- irq-gpios : Interrupt line of LSM303DLH Magnetometer.

Optional properties:
- negative_x, _y, _z : Orientation of Magnetometer about negative reference x,
  y, z axis. The value should be between 0 and 1.

Example:

magnetometer: lsm303dlh_m@0x1e {
	compatible = "st,lsm303dlh_m";
	reg = <0x1e>;
	name_a = "lsm303dlh_m";
	axis_map_x = <0>;
	axis_map_y = <1>;
	axis_map_z = <2>;
	irq-gpios  = <&gpiocontrol 70 0>;
};
```

## Documentation/devicetree/bindings/input/spear-l3g4200d.txt
```
* STMicroelectronics L3G4200D Gyroscope

Required properties:
- compatible : "st,l3g4200d_gyro"
- reg : the I2C address of L3G4200D
- poll_interval : The polling interval (in ms)
- min_interval : Minimum permitted polling interval
  The value for minimum poll interval should be 2.
- axis_map_x : Used to map the x axis to some other plane of reference.
  The value shall be between 0 to 2.
- axis_map_y : Used to map the x axis to some other plane of reference
  The value shall be between 0 to 2.
- axis_map_z : Used to map the x axis to some other plane of reference
  The value shall be between 0 to 2.

Optional properties:
- negate_x, _y, _z: flags to negate the output of x, y, z registers.
  Only 0 and 1 is allowed for negation boolean flag.

Example:

Gyroscope:l3g4200d_gyro@69 {
			compatible = "st,l3g4200d_gyro";
			reg = <0x69>;
			poll_interval = <5>;
			min_interval = <2>;
			axis_map_x = <0>;
			axis_map_y = <1>;
			axis_map_z = <2>;
};
```

## Documentation/devicetree/bindings/mmc/sdhci-spear.txt
```
* SPEAr SDHCI Controller

Required properties:
- compatible : "st,spear-sdhci"
- reg : Address range of the sdhci registers
- interrupt-parent: Should be the phandle for the interrupt controller
  that services interrupts for this device
- interrupt: Should contain the sdhci interrupt number

Optional Properties:
- power-gpio: specifies the power gpio pin with flags: active low:1, active
  high:0
- int-gpio: card detect interrupt gpio, with zero flags.

  If your board don't support these gpios then don't pass the entry.

- power_always_enb: power should be on before inserting the card and so can't be
  switched off. Only valid when power gpio is supported.

Example:

	sdhci@fc000000 {
		compatible = "st,spear-sdhci";
		reg = <0xfc000000 0x1000>;

		power-gpio = <&gpio0 5 0>
		int-gpio = <&gpio0 6 0>
		power_always_enb;
	};
```

## Documentation/devicetree/bindings/mtd/fsmc-nand.txt
```
* FSMC NAND

Required properties:
- compatible : "st,spear600-fsmc-nand"
- reg : Address range of the mtd chip
- reg-names: Should contain the reg names "fsmc_regs" and "nand_data"
- st,ale-off : Chip specific offset to ALE
- st,cle-off : Chip specific offset to CLE
- maxbanks: Number of banks supported by SoC

Optional properties:
- bank-width : Width (in bytes) of the device.  If not present, the width
  defaults to 1 byte
- nand-skip-bbtscan: Indicates the the BBT scanning should be skipped

- nand-timings-enabled: Indicates if the timing parameters are passed
  via DT
- nand-timings,tclr:
- nand-timings,tar:
- nand-timings,thiz:
- nand-timings,thold:
- nand-timings,twait:
- nand-timings,tset: All these timing parameters come from the actual
  nand device specification. Each of this represents a number of time
  period of hclk ie a number 4 in thold with hclk = 166MHz means that
  thold = (1000 / 166) * 4 ns = 24.09ns

- st,ready-busy: Should contain either of "rb-gpio" or "rb-wait". When
  this property is not defined, the default is to use rb-wait.
- st,rb-gpios: When the st,ready-busy is defined as "rb-gpio", a gpio
  pin number is defined in this property

- nand-erasesize: Pass erasesize of the connected NAND device
- nand-writesize: Pass writesize of the connected NAND device
- nand-oobsize: Pass oobsize of the connected NAND device
- nand-sw-ecc: boolean indicating whether s/w ecc is supported

Example:

	fsmc: flash@d1800000 {
		compatible = "st,spear600-fsmc-nand";
		#address-cells = <1>;
		#size-cells = <1>;
		reg = <0xd1800000 0x1000	/* FSMC Register */
		       0xd2000000 0x4000>;	/* NAND Base */
		reg-names = "fsmc_regs", "nand_data";
		st,ale-off = <0x20000>;
		st,cle-off = <0x10000>;
		maxbanks = <1>;

		nand-timings-enabled;
		nand-timings,tclr = <1>;
		nand-timings,tar = <1>;
		nand-timings,thiz = <1>;
		nand-timings,thold = <4>;
		nand-timings,twait = <6>;
		nand-timings,tset = <0>;

		bank-width = <1>;
		nand-skip-bbtscan;

		partition@0 {
			...
		};
	};
```

## Documentation/devicetree/bindings/net/can/c_can.txt
```
Bosch C_CAN/D_CAN controller Device Tree Bindings
-------------------------------------------------

Required properties:
- compatible		: Should be "bosch,c_can" for C_CAN controllers and
			  "bosch,d_can" for D_CAN controllers.
- reg			: physical base address and size of the C_CAN/D_CAN
			  registers map
- interrupts		: property with a value describing the interrupt
			  number
Optional properties:

- ti,hwmods		: Must be "d_can<n>" or "c_can<n>", n being the
			  instance number
- rx_split      : Receive message objects lying in the lower bucket
- tx_num        : Total number of transmit message objects
- reg_alignment : Signifies register alignment. Must be either of
                        1. 0x8 or 0x10 - If registers are 16-bit aligned
                        2. 0x18 - If registers are 32-bit aligned
                Default is 32-bit alignment.

Note:
1. "ti,hwmods" field is used to fetch the base address and irq resources from
   TI, omap hwmod data base during device registration.  Future plan is to
   migrate hwmod data base contents into device tree blob so that, all the
   required data will be used from device tree dts file.
2. Bosch C_CAN controller has 32 total message objects. RX first message object
   starts from 1. Depending upon the application, rx_split should lie somewhere
   between rx_first and rx_last (32 - tx_num)

Example:

Step1: SoC common .dtsi file

	dcan1: d_can@481d0000 {
		compatible = "bosch,d_can";
		reg = <0x481d0000 0x2000>;
		interrupts = <55>;
		interrupt-parent = <&intc>;
		status = "disabled";
	};

(or)

	dcan1: d_can@481d0000 {
		compatible = "bosch,d_can";
		ti,hwmods = "d_can1";
		reg = <0x481d0000 0x2000>;
		interrupts = <55>;
		interrupt-parent = <&intc>;
		status = "disabled";
	};

(or)

	can0@a1000000 {
		compatible = "bosch,c_can";
		ti,hwmods = "c_can0";
		reg = <0xa1000000 0x1000>;
		interrupts = <55>;
		interrupt-parent = <&intc>;
		reg_alignment = <0x10>;
		status = "disabled";
	};

(or)

	can1@a2000000 {
		compatible = "bosch,c_can";
		ti,hwmods = "c_can1";
		reg = <0xa2000000 0x1000>;
		interrupts = <55>;
		interrupt-parent = <&intc>;
		reg_alignment = <0x18>;
		status = "disabled";
	};

Step 2: board specific .dts file

	can0@a1000000 {
		rx_split = <16>;
		tx_num = <6>;
		status = "okay";
	};

(or)

	can1@a2000000 {
		status = "okay";
	};

(or)

	&dcan1 {
		status = "okay";
	};
```

## Documentation/devicetree/bindings/net/wan/spear_hdlc.txt
```
== ST SPEAr SoC HDLC controller ==

SPEAr family SoC provides two kinds of HDLC controller:
1. TDM/E1 HDLC controller 
2. RS485 HDLC controllers.

Both of them use similar DMA descriptor structure, similar interrupt
queue and so on. So both share the same driver code in Linux.

Required properties:
- compatible: should be one of:
  - "st,tdm_hdlc"
  - "st,rs485_hdlc"
- reg: physical base address and length of the controller's registers
- interrupt-parent : the phandle for the interrupt controller that
  services interrupts for this device.
- interrupt: Should contain the tdm or rs485 interrupt number

TDM optional properties:
-ip_type: SPEAr310 and SPEAr1310 have different configuration of HDLC
-nr_channel: number of logical channels on this port.
-nr_timeslot: number of timeslot actually using.
-tx_falling_edge: tx edge option
-rx_rising_edge: rx edge option
-ts0_delay: delay between SYNC and beginning of TS0

RS485 optional properties:
-tx_falling_edge: tx edge option
-rx_rising_edge: rx edge option
-cts_enable: CSMA enable or not
-cts_delay: CTS delay
```

## Documentation/devicetree/bindings/phy/st-spear1310-miphy.txt
```
ST SPEAr1310-miphy DT detail
===================================

SPEAr1310-miphy is a phy controller supporting PCIe and SATA.

Required properties:
- compatible : should be "st,spear1310-miphy"
- reg : offset and length of the PHY register set.
- misc: phandle for the syscon node to access misc registers
- phy-id: Instance id of the phy.
- #phy-cells : from the generic PHY bindings, must be 1.
	- cell[1]: 0 if phy used for SATA, 1 for PCIe.
```

## Documentation/devicetree/bindings/phy/st-spear1340-miphy.txt
```
ST SPEAr1340-miphy DT detail
===================================

SPEAr1340-miphy is a phy controller supporting PCIe and SATA.

Required properties:
- compatible : should be "st,spear1340-miphy"
- reg : offset and length of the PHY register set.
- misc: phandle for the syscon node to access misc registers
- #phy-cells : from the generic PHY bindings, must be 1.
	- cell[1]: 0 if phy used for SATA, 1 for PCIe.
```

## Documentation/devicetree/bindings/usb/dwc-usbd.txt
```
SYNOPSYS USB20 controllers:
-----------------------------

DWC-USB20:
--------

Required properties:
 -compatible: "snps, designware-usb""
 -interrupts: Should contain the usb otg interrupt.
 -reg: register base address.

Example:

usbd@e1100000 {
			compatible = "snps,designware-udc";
			reg = <0xe1100000 0x1000 	/* udc_csr_base */
				0xe1200000 0x1000>;	/* udc_plug_base */
			interrupts = <24>;
			status = "disabled";
		};
```

## Documentation/devicetree/bindings/usb/usb-otg.txt
```
SYNOPSYS OTG(DRD) controllers:
-----------------------------

USB-OTG:
--------

Required properties:
 -compatible: "snps, usb-otg""
 -interrupt-parent: Should be the phandle for the interrupt controller
  that services interrupts for this device
 -interrupts: Should contain the usb otg interrupt.
  For passing paltform data:
 -dev_rx_fifo_size: OTG Device rx fifo size.
 -dev_nperio_tx_fifo_size : Non periodic OTG Device tx fifo size.
 -fifo_number: Maximum number of fifo.
 -host_rx_fifo_size: OTG host rx fifo size.
 -host_nperio_tx_fifo_size : Non periodic OTG host tx fifo size.
 -host_perio_tx_fifo_size : periodic OTG host tx fifo size.

Example:

otg@e3800000 {
        compatible = "snps,usb-otg";
        reg = <0xe3800000 0x40000>;
        interrupts = <0 62 0x4>;
        dev_rx_fifo_size = <0x400>;
        dev_nperio_tx_fifo_size = <0x300>;
        fifo_number = <7>;
        host_rx_fifo_size = <0x400>;
        host_nperio_tx_fifo_size = <0x400>;
        host_perio_tx_fifo_size = <0x400>;
        status = "okay";
};
```
