## drivers/net/ethernet/stmicro/macb/Kconfig
```kconfig
#
# stmicro macb Network device configuration
#
config ETH_SPEAR_MACB
	bool "Cadence macb Ethernet adapted for SPEAr 320 Support"
	depends on ARM && MACH_SPEAR320
	select PHYLIB
	help
	  This is the driver for Cadence macb Ethernet controller
	  adopted for ST Micro SPEAr SOC. The driver adaptation takes
	  into account some of the fixes which are particular to SPEAr
	  SOC.
```

## sound/soc/spear/Kconfig
```kconfig
config SND_SPEAR13XX_EVM
	tristate "SoC Audio support for SPEAr13XX EVM"
	select SND_DESIGNWARE_I2S
	select SND_SOC_STA529
	select SND_SPEAR_SOC
	help
	 Say Y if you want to add support for SoC audio on SPEAr13XX
	 platform

config SND_SPEAR_SOC
	tristate "SoC Audio for the ST chip"
	depends on SND_DESIGNWARE_I2S
	help
	 Say Y or M if you want to add support for any of the audio
	 controllers. You will also need to select the audio
	 interface codecs to support below.

config SND_DESIGNWARE_I2S
	tristate "Synopsys I2S Device Driver"
	help
	 Say Y or M if you want to add support for I2S driver for
	 Synopsys desigwnware I2S device. The device supports upto
	 maximum of 8 channels each for play, record or both.
```
